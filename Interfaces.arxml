AUTOSAR XML (schema 00046)
package /Interfaces
  sender receiver interface SRIF
    data x: type=uint8
