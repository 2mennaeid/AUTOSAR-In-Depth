AUTOSAR XML (schema 00046)
package /SWCs_EABS_Package1
  sensor actuator sw component type Lidar_SWC1
  sensor actuator sw component type Speed_SWC2
  application sw component type EABS_SWC3
  parameter sw component type P_D_SWC4
  sensor actuator sw component type Warning_Led_SWC5
  service sw component type DIgMang_Service_SWC6
  nv block sw component type Flash_NVB_SWC7
  complex device driver sw component type Breaking_SWC8
  ecu abstraction sw component type IOAbst_SWC9
